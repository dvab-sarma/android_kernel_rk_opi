## drivers/net/wireless/rockchip_wlan/rkwifi/Kconfig
```kconfig
# SPDX-License-Identifier: GPL-2.0
config AP6XXX
	tristate "ap6xxx wireless cards support"
	depends on RFKILL_RK
	depends on CFG80211 && MAC80211
	default m if RFKILL_RK
	help
	  This module adds support for wireless adapters based on
	  Broadcom ap6xxx chipset.

	  This driver uses the kernel's wireless extensions subsystem.

	  If you choose to build a module, it'll be called dhd. Say M if
	  unsure.

choice
	prompt "Enable Chip Interface"
	depends on BCMDHD
	default BCMDHD_SDIO
	help
	  Enable Chip Interface.

config BCMDHD_SDIO
	bool "SDIO bus interface support"
	depends on BCMDHD && MMC

config BCMDHD_PCIE
	bool "PCIe bus interface support"
	depends on BCMDHD && PCI

endchoice

config PCIEASPM_ROCKCHIP_WIFI_EXTENSION
	bool "Extend ASPM function"
	depends on BCMDHD_PCIE && PCIEASPM_EXT
	help
	  This enables the extensions APIs for ASPM control.

config BCMDHD_REQUEST_FW 
	bool "Request Firmware"
	depends on BCMDHD
	help
	  Requests firmware using request_firmware api

config BCMDHD_FW_PATH
	depends on BCMDHD
	string "Firmware path"
	default "/vendor/etc/firmware/fw_bcmdhd.bin"
	help
	  Path to the firmware file.

config BCMDHD_NVRAM_PATH
	depends on BCMDHD
	string "NVRAM path"
	default "/vendor/etc/firmware/nvram.txt"
	help
	  Path to the calibration file.

config BCMDHD_CLM_PATH
	depends on BCMDHD
	string "CLM path"
	default "/vendor/etc/firmware/clm_bcmdhd.blob"
	help
	  Path to the CLM file.

config BCMDHD_CONFIG_PATH
	depends on BCMDHD
	string "Config path"
	default "/vendor/etc/firmware/config.txt"
	help
	  Path to the config file.

config BCMDHD_STATIC_IF
	bool "Enable wlan1 support"
	help
	  default to add wlan1 interface
```
